/* source keypos definitions */
#include "../zmk-nodefree-config/keypos_def/keypos_adv360.h"

/* map 360's extra keys */
#define X_LT    &kp EQUAL &kp N1 &kp N2 &kp N3 &kp N4 &kp N5 &smart_nav     &smart_nav &kp N6 &kp N7 &kp N8 &kp N9 &kp N0 &kp MINUS \
                &kp TAB
#define X_LT_FN &kp F1 &kp F2 &kp F3 &kp F4 &kp F5 &kp F6 &smart_nav     &smart_nav &kp F7 &kp F8 &kp F9 &kp F10 &kp F11 &kp F12 \
                &kp TAB

#define X_MT    SMART_NUM &tog NAV
#define X_RT    &kp BSLH

#define X_LM    &kp ESC
#define X_MM    &tog NUM &smart_mouse
#define X_RM    &kp SQT

#define X_LB    &kp LSHFT
#define X_RB    &kp RSHFT

#define X_LH    &mo FN  &kp GRAVE &kp CAPS  &mo MOUSE &mo FN     SMART_NUM &kp LGUI &kp LBKT &kp RBKT &mo FN  \
                &kp LCTRL &kp LALT      &kp LGUI  &kp RCTRL
#define X_MH    &kp HOME    &kp PG_UP
#define X_RH    &kp END     &kp PG_DN

/* activate bluetooth */
#define CONFIG_WIRELESS 1

/* leds and backlights */
#include <dt-bindings/zmk/rgb.h>
#include <dt-bindings/zmk/backlight.h>

/* source the main keymap */
#include "base.keymap"

/* use urob's layout for Advantage 360 pro */
/ { chosen { zmk,matrix_transform = &urobs_transform; }; };

