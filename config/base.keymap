#include <behaviors.dtsi>
#include <dt-bindings/zmk/keys.h>
#if CONFIG_WIRELESS
    #include <dt-bindings/zmk/bt.h>
    #define _BT_SEL_KEYS_ &bt BT_SEL 0 &bt BT_SEL 1 &bt BT_SEL 2 &bt BT_SEL 3 &bt BT_CLR
#else
    #define _BT_SEL_KEYS_ &trans &trans &trans &trans &trans
#endif

#include "zmk-helpers/helper.h"

#include <dt-bindings/zmk/mouse.h>
#include <dt-bindings/zmk/outputs.h>
#include <dt-bindings/zmk/rgb.h>
#include <input/processors.dtsi>
#include <behaviors/input_gestures_accel.dtsi>   // oleksandrmaslov/zmk-pointing-acceleration: &pointer_accel
#include <dt-bindings/zmk/input_transform.h>


#define DEF 0
#define FN 1
#define NUM 2
#define SYS 3
#define MOUSE 4
#define AUTOMOUSE 5   // pointer-triggered auto-mouse layer (Part F)

#include "combos.dtsi"  // requires layer aliases
#include "mouse.dtsi"
#include "extra_keys.h"

#define XXX &none
#define ___ &trans

/* Global settings */

#define QUICK_TAP_MS 175

&sk {  // sticky-key config
    release-after-ms = <900>;  // release after 0.6s
    quick-release;             // no double capitalization when rolling keys
};

&sl {  // sticky-layer config
    ignore-modifiers;          // allow chording sticky mods & layers
    release-after-ms = <1500>;  // release after 1.5s
};

&lt {  // layer-tap config
    flavor = "balanced";
    tapping-term-ms = <200>;
    quick-tap-ms = <QUICK_TAP_MS>;
};

/* Homerow mods */

#define KEYS_L LT0 LT1 LT2 LT3 LT4 LM0 LM1 LM2 LM3 LM4 LB0 LB1 LB2 LB3 LB4  // left hand
#define KEYS_R RT0 RT1 RT2 RT3 RT4 RM0 RM1 RM2 RM3 RM4 RB0 RB1 RB2 RB3 RB4  // right hand
#define THUMBS LH1 LH0 RH0 RH1                                              // thumbs

#define MAKE_HRM(NAME, HOLD, TAP, TRIGGER_POS) \
    ZMK_BEHAVIOR(NAME, hold_tap, \
        flavor = "balanced"; \
        tapping-term-ms = <280>; \
        quick-tap-ms = <QUICK_TAP_MS>; \
        require-prior-idle-ms = <150>; \
        bindings = <HOLD>, <TAP>; \
        hold-trigger-key-positions = <TRIGGER_POS>; \
        hold-trigger-on-release; \
    )
MAKE_HRM(hml, &kp, &kp, KEYS_R THUMBS)  // left-hand HRMs
MAKE_HRM(hmr, &kp, &kp, KEYS_L THUMBS)  // right-hand HRMs

MAKE_HRM(hml_fn, &mo, &kp, KEYS_R THUMBS)  // left-hand HRMs with fn layer
MAKE_HRM(hmr_fn, &mo, &kp, KEYS_L THUMBS)  // right-hand HRMs with fn layer

MAKE_HRM(hml_repeat, &kp, &key_repeat, KEYS_R THUMBS)  // used for HRM-combo
MAKE_HRM(hmr_lpar_lt, &kp, &lpar_lt, KEYS_L THUMBS)    // "    "   "   "
MAKE_HRM(hmr_rpar_gt, &kp, &rpar_gt, KEYS_L THUMBS)    // "    "   "   "

/* Nav cluster */

// long-tap action on hold, short-tap action on all interrupts
#define MT_CORE \
    flavor = "tap-preferred"; \
    tapping-term-ms = <220>; \
    quick-tap-ms = <220>; \
    hold-trigger-key-positions = <0>;

&mt { MT_CORE };
ZMK_BEHAVIOR(mt_home, hold_tap, bindings = <&masked_home>, <&kp>; MT_CORE)
ZMK_BEHAVIOR(mt_end,  hold_tap,  bindings = <&masked_end>, <&kp>; MT_CORE)

#define NAV_LEFT  &mt_home 0   LEFT    // tap: left  | long-tap: beginning of line
#define NAV_RIGHT &mt_end 0    RIGHT   // tap: right | long-tap: end       of line
#define NAV_UP    &mt LC(HOME) UP      // tap: up    | long-tap: beginning of document
#define NAV_DOWN  &mt LC(END)  DOWN    // tap: down  | long-tap: end       of document
#define NAV_BSPC  &mt LC(BSPC) BSPC    // tap: bspc  | long-tap: delete word backward
#define NAV_DEL   &mt LC(DEL)  DEL     // tap: del   | long-tap: delete word forward

// mask CTRL when holding left/right to avoid accidental jumps to beginning/end of document
#define MASK_MODS(NAME, MODS, BINDING) \
    ZMK_MOD_MORPH(NAME, \
        bindings = <BINDING>, <BINDING>; \
        mods = <MODS>; \
    )
MASK_MODS(masked_home, (MOD_LCTL), &kp HOME)
MASK_MODS(masked_end,  (MOD_LCTL), &kp END)

/* Caps-word, num-word and smart-mouse */

// tap: sticky-shift | shift + tap/ double-tap: caps-word | hold: shift
ZMK_MOD_MORPH(smart_shft,
    bindings = <&sk LSHFT>, <&caps_word>;
    mods = <(MOD_LSFT)>;
)
&caps_word {  // mods deactivate caps-word, requires PR #1451
    /delete-property/ ignore-modifiers;
};

// tap: num-layer | double-tap: sticky num-layer | hold: num-layer
#define SMART_NUM &smart_num NUM 0
ZMK_HOLD_TAP(smart_num,
    flavor = "balanced";
    tapping-term-ms = <200>;
    quick-tap-ms = <120>;
    bindings = <&mo>, <&sl>;
)

// smart-mouse, requires PR #1366
ZMK_TRI_STATE(smart_mouse,
    bindings = <&tog MOUSE>, <&none>, <&tog MOUSE>;
    ignored-key-positions = <LT1 LT3 RT1 RT2 RT3 RM0 RM1 RM2 RM3 RM4 RH0 RH1>;
    ignored-layers = <MOUSE>;
)

/* Custom behaviors */

// Alt+Tab swapper, requires PR #1366
ZMK_TRI_STATE(swapper,
    bindings = <&kt LALT>, <&kp TAB>, <&kt LALT>;
    ignored-key-positions = <LT2>;
)

// reuse basic mod-morph scheme
#define SIMPLE_MORPH(NAME, MOD, BINDING1, BINDING2) \
    ZMK_MOD_MORPH(NAME, \
        mods = <(MOD_L ## MOD|MOD_R ## MOD)>; \
        bindings = <BINDING1>, <BINDING2>; \
    )

// tap: comma | shift + tap: semicolon | ctrl + shift + tap: <
ZMK_BEHAVIOR(comma_morph, mod_morph,
    mods = <(MOD_LSFT|MOD_RSFT)>;
    bindings = <&kp COMMA>, <&comma_inner_morph>;
)
ZMK_BEHAVIOR(comma_inner_morph, mod_morph,
    bindings = <&kp SEMICOLON>, <&kp LESS_THAN>;
    mods = <(MOD_LCTL|MOD_RCTL)>;
)

// tap: comma | shift + tap: semicolon | ctrl + shift + tap: <
SIMPLE_MORPH(comma_morph, SFT, &kp COMMA, &comma_inner_morph)
SIMPLE_MORPH(comma_inner_morph, CTL, &kp SEMICOLON, &kp LESS_THAN)

// tap: dot | shift + tap: colon | ctrl + shift + tap: >
SIMPLE_MORPH(dot_morph, SFT, &kp DOT, &dot_inner_morph)
SIMPLE_MORPH(dot_inner_morph, CTL, &kp COLON, &kp GREATER_THAN)

// tap: qmark | shift + tap: excl
SIMPLE_MORPH(qexcl, SFT, &kp QMARK, &kp EXCL)

// tap: left/right parenthesis | shft + tap: less-than/greater-than
SIMPLE_MORPH(lpar_lt, SFT, &kp LPAR, &kp LT)
SIMPLE_MORPH(rpar_gt, SFT, &kp RPAR, &kp GT)

// tap: space | shift + tap: dot -> space -> sticky shift | hold: activate layer
ZMK_BEHAVIOR(lt_spc, hold_tap,
    flavor = "balanced";
    tapping-term-ms = <200>;
    quick-tap-ms = <QUICK_TAP_MS>;
    bindings = <&mo>, <&spc_morph>;
)
ZMK_BEHAVIOR(spc_morph, mod_morph,
    bindings = <&kp SPACE>, <&dot_spc>;
    mods = <(MOD_LSFT|MOD_RSFT)>;
)
ZMK_MACRO(dot_spc,
    wait-ms = <0>;
    tap-ms = <5>;
    bindings = <&kp DOT &kp SPACE &sk LSHFT>;
)

// tap: backspace | lshft + tap: delete | rshft + tap: shift-delete
ZMK_MOD_MORPH(bs_del,
    bindings = <&kp BSPC>, <&kp DEL>;
    mods = <(MOD_LSFT|MOD_RSFT)>;
    keep-mods = <MOD_RSFT>;
)

// tap: left-parenthesis | shft + tap: less-than
ZMK_MOD_MORPH(lpar_lt,
    bindings = <&kp LPAR>, <&kp LT>;
    mods = <(MOD_LSFT|MOD_RSFT)>;
)

// tap: right-parenthesis | shft + tap: greater-than
ZMK_MOD_MORPH(rpar_gt,
    bindings = <&kp RPAR>, <&kp GT>;
    mods = <(MOD_LSFT|MOD_RSFT)>;
)

// tap: copy | double-tap: cut
ZMK_TAP_DANCE(copy_cut,
    tapping-term-ms = <200>;
    bindings = <&kp LC(INS)>, <&kp LC(X)>;
)

// Windows sleep key
ZMK_MACRO(win_sleep,
    wait-ms = <500>;
    tap-ms = <50>;
    bindings = <&kp LG(X) &kp U &kp S>;
)

// misc aliases
#define CANCEL      &kp K_CANCEL             // cancel caps-word, num-word and smart-mouse
#define DSK_PREV    &hmr LCTRL LG(LC(LEFT))   // previous desktop
#define DSK_NEXT    &hmr LALT LG(LC(RIGHT)) // next     desktop
#define PIN_WIN     &kp LG(LC(LS(Q)))        // pin window across desktops
#define PIN_APP     &kp LG(LC(LS(A)))        // pin application across desktops
#define DSK_MGR     &kp LA(GRAVE)            // desktop manager
#define VOL_DOWN    &hmr RSHFT C_VOL_DN

#define LED_RGB_OFF &rgb_ug RGB_OFF
#define LED_RGB_ON  &rgb_ug RGB_ON
#define LED_RGB_EFF &rgb_ug RGB_EFF
#define LED_RGB_EFR &rgb_ug RGB_EFR
#define LED_RGB_SPI &rgb_ug RGB_SPI
#define LED_RGB_BRI &rgb_ug RGB_BRI
#define LED_RGB_BRD &rgb_ug RGB_BRD

#define ZMK_MOUSE_DEFAULT_MOVE_VAL 1200  // 600
#define ZMK_MOUSE_DEFAULT_SCRL_VAL 20    // 10

/* Keymap */

// The below statement makes both &tog and &mo SYS layer not working
// ZMK_CONDITIONAL_LAYER(MOUSE FN, SYS)  // NAV + NUM --> SYS

/ {
    rgb_encoder: rgb_encoder {
        compatible = "zmk,behavior-sensor-rotate";
        #sensor-binding-cells = <0>;
        bindings = <&rgb_ug RGB_BRI>, <&rgb_ug RGB_BRD>;
    };
    scroll_encoder: scroll_encoder {
      compatible = "zmk,behavior-sensor-rotate";
      #sensor-binding-cells = <0>;
      bindings = <&msc SCRL_DOWN>, <&msc SCRL_UP>;
      tap-ms = <30>;
  };
};

/* Cursor (pointer) acceleration -- oleksandrmaslov/zmk-pointing-acceleration, the
 * module's "Precision Mode" preset: 0.5x for fine control at slow speeds, ramping to
 * 1.5x at high speed on a linear curve, with a high 1.0x threshold for stability.
 * The module acts ONLY on REL_X/REL_Y (its accel_codes[] are hardcoded to the cursor
 * axes), so it does NOT touch REL_WHEEL/REL_HWHEEL -- it composes cleanly with the
 * driver's scroll acceleration + inertia (they operate on disjoint event codes). */
&pointer_accel {
    input-type = <INPUT_EV_REL>;
    track-remainders;             /* accumulate fractional movement for precision */
    min-factor = <500>;           /* 0.5x at very slow speeds (fine control) */
    max-factor = <1500>;          /* up to 1.5x at high speed */
    speed-threshold = <2000>;     /* counts/sec that maps to 1.0x (high = stable) */
    speed-max = <7000>;           /* counts/sec at which max-factor is reached */
    acceleration-exponent = <1>;  /* linear response */
};

/* Azoteq IQS5xx touchpad: cursor acceleration + orientation transforms on the central
 * listener. Attached here (not in the board dtsi) because <input/processors.dtsi> is
 * already included above; declaring it twice would duplicate nodes.
 * Flags mirror the rolio reference; adjust per guide section 9.3 if axes are wrong.
 * &pointer_accel is first so it accelerates the raw relayed cursor movement; it leaves
 * the wheel untouched, so the driver's scroll accel/inertia still own scrolling. */
/* Pinch-to-zoom -> a REAL Left-Ctrl, with NO host-side remapper (see docs Problem 21).
 * The driver holds mouse button 5 (INPUT_BTN_4) for the whole pinch; this
 * `zmk,input-processor-behaviors` instance converts that button into a genuine `&kp LCTRL`
 * on the CENTRAL keyboard HID -- pressed at pinch start, released at pinch end -- via the
 * exact path a physical Ctrl key uses, and STOPs the event so it is never also emitted as a
 * phantom HID mouse button. Composed with the driver's REL_WHEEL steps, the host receives a
 * real keyboard Ctrl + a real mouse wheel = zoom in EVERY application (Chrome, Qt apps, ...),
 * identical to a physical keyboard + mouse. This replaces the fragile input-remapper
 * button5->Ctrl mapping, which injected Ctrl on a separate virtual keyboard device and let
 * the wheel be re-injected/mangled -- the reason Chromium ignored it and Qt apps zoomed one
 * way only. INPUT_BTN_4 is now consumed here, so do NOT also bind it as a normal mouse btn. */
/ {
    zip_zoom_ctrl: zip_zoom_ctrl {
        compatible = "zmk,input-processor-behaviors";
        #input-processor-cells = <0>;
        codes = <INPUT_BTN_4>;
        bindings = <&kp LCTRL>;
    };

    /* Two-finger double-tap -> a real Left-Super (GNOME Activities overview). The driver pulses
     * INPUT_BTN_3 on the second 2-finger tap; this maps it to a `&kp LGUI` tap and STOPs it so it
     * is never emitted as a phantom HID mouse button. Same native mechanism -- and the same
     * mandatory CONFIG_INPUT_THREAD_STACK_SIZE=4096 -- as zip_zoom_ctrl. See gestures guide Part J. */
    zip_activities_super: zip_activities_super {
        compatible = "zmk,input-processor-behaviors";
        #input-processor-cells = <0>;
        codes = <INPUT_BTN_3>;
        bindings = <&kp LGUI>;
    };
};

&tps43_listener {
    input-processors =
        <&zip_zoom_ctrl>,                  /* pinch button5 -> real Left-Ctrl, then STOP */
        <&zip_activities_super>,           /* 2-finger double-tap button4 -> real Left-Super, then STOP */
        <&pointer_accel>,
        <&zip_xy_transform (INPUT_TRANSFORM_XY_SWAP | INPUT_TRANSFORM_X_INVERT)>,
        <&zip_scroll_transform (INPUT_TRANSFORM_XY_SWAP)>,
        <&zip_temp_layer AUTOMOUSE 600>;   /* Part F: motion auto-enables AUTOMOUSE for 600ms */
};

/* Auto-mouse layer behaviour (Part F).
 * - excluded-positions: the click keys (SPACE=LH0, ENTER=RH0). Pressing any
 *   OTHER key exits AUTOMOUSE; pressing the click keys keeps it alive. With the
 *   list empty, NO key would ever exit it (only the timeout) -- so it must be set.
 * - require-prior-idle-ms: ignore pad motion within 150ms of a keystroke, so a
 *   stray brush while typing doesn't pop the layer and turn the next key into a click. */
&zip_temp_layer {
    require-prior-idle-ms = <150>;
    excluded-positions = <LH0 RH0>;
};

/* Extend-on-click: route mouse-button presses through zip_temp_layer too, so
 * each click re-arms the AUTOMOUSE timeout during slow move -> click sequences. */
&mkp_input_listener {
    input-processors = <&zip_temp_layer AUTOMOUSE 600>;
};

ZMK_LAYER(base,
//╭──────╮ ╭─────────────┬─────────────┬─────────────┬─────────────┬─────────────╮ ╭──────╮ ╭─────────────┬─────────────┬─────────────┬─────────────┬─────────────╮ ╭──────╮
    X_LT     &kp Q         &kp W         &kp E         &kp R         &kp T           X_MT     &kp Y         &kp U         &kp I         &kp O         &kp P          X_RT
//├──────┤ ├─────────────┼─────────────┼─────────────┼─────────────┼─────────────┤ ├──────┤ ├─────────────┼─────────────┼─────────────┼─────────────┼─────────────┤ ├──────┤
    X_LM     &hml LSHFT A  &hml LCTRL S   &hml LALT D  &kp F         &kp G           X_MM     &kp H         &kp J         &hmr LALT K  &hmr LCTRL L   &hmr RSHFT SEMI X_RM
//├──────┤ ├─────────────┼─────────────┼─────────────┼─────────────┼─────────────┤ ├──────┤ ├─────────────┼─────────────┼─────────────┼─────────────┼─────────────┤ ├──────┤
    X_LB     &kp Z         &kp X         &kp C         &kp V         &kp B           X_MB     &kp N         &kp M         &kp COMMA     &kp DOT       &kp SLASH       X_RB
//├──────┤ ╰─────────────┼─────────────┴─────────────┼─────────────┼─────────────┤ ├──────┤ ├─────────────┼─────────────┼─────────────┴───────────────────────────╯ ├──────┤
    X_LH                                               &mo MOUSE     &mo FN          X_MH     SMART_NUM     &kp LGUI                                                  X_RH
//╰──────╯                                           ╰─────────────┴─────────────╯ ╰──────╯ ╰─────────────┴─────────────╯                                           ╰──────╯
)

ZMK_LAYER(fn,
//╭──────╮ ╭─────────────┬─────────────┬─────────────┬─────────────┬─────────────╮ ╭──────╮ ╭─────────────┬─────────────┬─────────────┬─────────────┬─────────────╮ ╭──────╮
    X_LT    &kp F12        &kp F7        &kp F8        &kp F9       &kp PSCRN        X_MT     &kp PG_UP     &kp HOME      &kp UP        &kp END       ___             X_RT
//├──────┤ ├─────────────┼─────────────┼─────────────┼─────────────┼─────────────┤ ├──────┤ ├─────────────┼─────────────┼─────────────┼─────────────┼─────────────┤ ├──────┤
    X_LM    &hml LSHFT F11 &hml LCTRL F4 &hml LALT F5  &kp F6       &kp SLCK         X_MM     &kp PG_DN     &kp LEFT      &kp DOWN      &kp RIGHT     ___             X_RM
//├──────┤ ├─────────────┼─────────────┼─────────────┼─────────────┼─────────────┤ ├──────┤ ├─────────────┼─────────────┼─────────────┼─────────────┼─────────────┤ ├──────┤
    X_LB    &kp F10        &kp F1        &kp F2        &kp F3       &kp PAUSE_BREAK  X_MB     &kp INS       &kp DEL       ___           ___           ___             X_RB
//├──────┤ ╰─────────────┼─────────────┴─────────────┼─────────────┼─────────────┤ ├──────┤ ├─────────────┼─────────────┼─────────────┴───────────────────────────╯ ├──────┤
    X_LH                                               &mo SYS       ___             X_MH     ___           ___                                                       X_RH
//╰──────╯                                           ╰─────────────┴─────────────╯ ╰──────╯ ╰─────────────┴─────────────╯                                           ╰──────╯
, &scroll_encoder
)

ZMK_LAYER(num,
//╭──────╮ ╭─────────────┬─────────────┬─────────────┬─────────────┬─────────────╮ ╭──────╮ ╭─────────────┬─────────────┬─────────────┬─────────────┬─────────────╮ ╭──────╮
    X_LT     &kp EXCL      &kp N7        &kp N8        &kp N9        &kp PERCENT     X_MT     &kp CARET     &kp AMPS      &kp STAR      ___           ___             X_RT
//├──────┤ ├─────────────┼─────────────┼─────────────┼─────────────┼─────────────┤ ├──────┤ ├─────────────┼─────────────┼─────────────┼─────────────┼─────────────┤ ├──────┤
    X_LM     &hml LSHFT N0 &hml LCTRL N4 &hml LALT N5  &hml LGUI N6  &kp DOLLAR      X_MM     ___           ___           ___           ___           ___             X_RM
//├──────┤ ├─────────────┼─────────────┼─────────────┼─────────────┼─────────────┤ ├──────┤ ├─────────────┼─────────────┼─────────────┼─────────────┼─────────────┤ ├──────┤
    X_LB     &kp AT        &kp N1        &kp N2        &kp N3        &kp HASH        X_MB     ___           ___           ___           ___           ___             X_RB
//├──────┤ ╰─────────────┼─────────────┴─────────────┼─────────────┼─────────────┤ ├──────┤ ├─────────────┼─────────────┼─────────────┴───────────────────────────╯ ├──────┤
    X_LH                                               ___           ___             X_MH     ___           ___                                                       X_RH
//╰──────╯                                           ╰─────────────┴─────────────╯ ╰──────╯ ╰─────────────┴─────────────╯                                           ╰──────╯
, &scroll_encoder
)

ZMK_LAYER(sys,
//╭──────╮ ╭─────────────┬─────────────┬─────────────┬─────────────┬─────────────╮ ╭──────╮ ╭─────────────┬─────────────┬─────────────┬─────────────┬─────────────╮ ╭──────╮
    X_LT                                _BT_SEL_KEYS_                                X_MT     ___           ___           ___           ___                 ___       X_RT
//├──────┤ ├─────────────┼─────────────┼─────────────┼─────────────┼─────────────┤ ├──────┤ ├─────────────┼─────────────┼─────────────┼─────────────┼─────────────┤ ├──────┤
    X_LM     ___           &sys_reset    ___           ___           &bootloader     X_MM     &bootloader   ___           ___           &sys_reset          ___       X_RM
//├──────┤ ├─────────────┼─────────────┼─────────────┼─────────────┼─────────────┤ ├──────┤ ├─────────────┼─────────────┼─────────────┼─────────────┼─────────────┤ ├──────┤
    X_LB     LED_RGB_OFF   LED_RGB_ON    ___           ___           LED_RGB_EFF     X_MB     LED_RGB_EFR   LED_RGB_SPI   LED_RGB_BRI   LED_RGB_BRD         ___       X_RB
//├──────┤ ╰─────────────┼─────────────┴─────────────┼─────────────┼─────────────┤ ├──────┤ ├─────────────┼─────────────┼─────────────┴───────────────────────────╯ ├──────┤
    X_LH                                               ___           ___             X_MH     ___           ___                                                       X_RH
//╰──────╯                                           ╰─────────────┴─────────────╯ ╰──────╯ ╰─────────────┴─────────────╯                                           ╰──────╯
, &scroll_encoder
)

ZMK_LAYER(mouse,
//╭──────╮ ╭─────────────┬─────────────┬─────────────┬─────────────┬─────────────╮ ╭──────╮ ╭─────────────┬─────────────┬─────────────┬─────────────┬─────────────╮ ╭──────╮
    X_LT     ___           ___           ___           ___           ___             X_MT_M   ___           U_WH_U        U_MS_U         U_WH_D       ___             X_RT
//├──────┤ ├─────────────┼─────────────┼─────────────┼─────────────┼─────────────┤ ├──────┤ ├─────────────┼─────────────┼─────────────┼─────────────┼─────────────┤ ├──────┤
    X_LM     ___           ___           ___           ___           ___             X_MM_M   U_WH_L        U_MS_L        U_MS_D         U_MS_R       U_WH_R          X_RM
//├──────┤ ├─────────────┼─────────────┼─────────────┼─────────────┼─────────────┤ ├──────┤ ├─────────────┼─────────────┼─────────────┼─────────────┼─────────────┤ ├──────┤
    X_LB     ___           ___           ___           ___           ___             X_MB_M   ___           ___           ___            ___          ___             X_RB
//├──────┤ ╰─────────────┼─────────────┴─────────────┼─────────────┼─────────────┤ ├──────┤ ├─────────────┼─────────────┼─────────────┴───────────────────────────╯ ├──────┤
    X_LH                                               ___           ___             X_MH_M   &mkp MCLK     ___                                                       X_RH
//╰──────╯                                           ╰─────────────┴─────────────╯ ╰──────╯ ╰─────────────┴─────────────╯                                           ╰──────╯
, &scroll_encoder
)

// Auto-mouse layer (Part F): auto-enabled by touchpad motion via zip_temp_layer.
// Transparent everywhere so typing falls through, except the thumb click keys:
// SPACE (LH0) -> right-click, ENTER/RET (RH0) -> left-click.
ZMK_LAYER(automouse,
//╭──────╮ ╭─────────────┬─────────────┬─────────────┬─────────────┬─────────────╮ ╭──────╮ ╭─────────────┬─────────────┬─────────────┬─────────────┬─────────────╮ ╭──────╮
    X_LT     ___           ___           ___           ___           ___             X_MT_A   ___           ___           ___           ___          ___             X_RT
//├──────┤ ├─────────────┼─────────────┼─────────────┼─────────────┼─────────────┤ ├──────┤ ├─────────────┼─────────────┼─────────────┼─────────────┼─────────────┤ ├──────┤
    X_LM     ___           ___           ___           ___           ___             X_MM_A   ___           ___           ___           ___          ___             X_RM
//├──────┤ ├─────────────┼─────────────┼─────────────┼─────────────┼─────────────┤ ├──────┤ ├─────────────┼─────────────┼─────────────┼─────────────┼─────────────┤ ├──────┤
    X_LB     ___           ___           ___           ___           ___             X_MB_A   ___           ___           ___           ___          ___             X_RB
//├──────┤ ╰─────────────┼─────────────┴─────────────┼─────────────┼─────────────┤ ├──────┤ ├─────────────┼─────────────┼─────────────┴───────────────────────────╯ ├──────┤
    X_LH                                               ___           ___             X_MH_A   ___           ___                                                       X_RH
//╰──────╯                                           ╰─────────────┴─────────────╯ ╰──────╯ ╰─────────────┴─────────────╯                                           ╰──────╯
, &scroll_encoder
)

/* vim: set ft=c tw=174: */
