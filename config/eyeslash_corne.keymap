// Source keypos definitions
#include "key-labels/eyelash_corne_42.h"

/* map Corne's extra keys */
#define X_LT    &kp TAB
#define X_RT    &kp BSLH

#define X_LM    &kp ESC
#define X_RM    &kp SQT

#define X_LB    &kp LSHFT
#define X_RB    &kp RSHFT

#define X_MH    &kp SPACE  &kp RET 
#define X_MH_M  &mkp LCLK  &mkp RCLK

#define X_MT                        &kp UP
#define X_MM              &kp LEFT  &kp ENTER  &kp RIGHT
#define X_MB    &kp SPACE           &kp DOWN

#define X_MT_M                             &mmv MOVE_UP
#define X_MM_M             &mmv MOVE_LEFT  &mkp LCLK       &mmv MOVE_RIGHT
#define X_MB_M  &kp C_MUTE                 &mmv MOVE_DOWN


/* activate bluetooth */
#define CONFIG_WIRELESS 1

/* leds and backlights */
#include <dt-bindings/zmk/rgb.h>
#include <dt-bindings/zmk/backlight.h>

/* source the main keymap */
#include "base.keymap"
