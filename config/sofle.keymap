/* source keypos definitions */
#include "../zmk-nodefree-config/keypos_def/keypos_60keys.h"

/* map Sofle's extra keys */
#define X_LT    &kp EQUAL &kp N1 &kp N2 &kp N3 &kp N4 &kp N5     &kp N6 &kp N7 &kp N8 &kp N9 &kp N0 &kp MINUS \
                &kp TAB
#define X_LT_FN &kp F1 &kp F2 &kp F3 &kp F4 &kp F5 &kp F6  &kp F7 &kp F8 &kp F9 &kp F10 &kp F11 &kp F12 \
                &kp TAB

#define X_RT    &kp BSLH

#define X_LM    &kp ESC
#define X_RM    &kp SQT

#define X_LB    &kp LSHFT
#define X_RB    &kp RSHFT

#define X_MB    &hml_fn MOUSE LGUI &kp BKSP
#define X_MB_M  &hml_fn MOUSE LGUI U_BTN1

#define X_LH    &tog NUM &kp CAPS  &hml LGUI GRAVE  &mo FN  &kp SPACE    &kp RET SMART_NUM &kp LBKT &kp RBKT ___ &tog NAV U_WH_R U_WH_U U_WH_L U_WH_D 
#define X_LH_NUM    &tog NUM &kp CAPS &mo SYS &mo FN  &kp SPACE   &kp RET SMART_NUM &kp LBKT &kp RBKT ___ &tog NAV U_WH_R U_WH_U U_WH_L U_WH_D
#define X_LH_MOUSE  ___       ___     ___     ___       ___                  U_BTN2     ___             ___      ___ 

/* activate bluetooth */
#define CONFIG_WIRELESS 1

/* leds and backlights */
#include <dt-bindings/zmk/rgb.h>
#include <dt-bindings/zmk/backlight.h>

/* source the main keymap */
#include "base_sofle.keymap"
