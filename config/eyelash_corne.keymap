// Source keypos definitions
#include "key-labels/eyelash_corne_42.h"

/* map Corne's extra keys */
#define X_LT    &kp TAB
#define X_RT    &kp BSLH

#define X_LM    &kp ESC
#define X_RM    &kp SQT

#define X_LB    &kp LSHFT
#define X_RB    &kp RSHFT

#define X_MH    &kp SPACE  &kp RET 
#define X_MH_M  &mkp LCLK  &mkp RCLK

/* This hardware is a plain 42-key Corne: NO joystick middle column and NO encoder.
 * Keep the middle-column extras (X_MT/X_MM/X_MB) EMPTY so every alpha row is 12 keys
 * (6 left + 6 right) and the layout matches rolio's 42-key transform exactly. The
 * middle *thumb* (X_MH = SPACE/RET) is kept -- it is the 3rd thumb of each half. */
#define X_MT
#define X_MM
#define X_MB

#define X_MT_M
#define X_MM_M
#define X_MB_M

/* auto-mouse layer (Part F): the middle thumb (X_MH_A) does the clicks. */
#define X_MT_A
#define X_MM_A
#define X_MB_A
#define X_MH_A  &mkp RCLK  &mkp LCLK


/* activate bluetooth */
#define CONFIG_WIRELESS 1

/* leds and backlights */
#include <dt-bindings/zmk/rgb.h>
#include <dt-bindings/zmk/backlight.h>

/* source the main keymap */
#include "base.keymap"
